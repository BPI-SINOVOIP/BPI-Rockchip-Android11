## external/u-boot/configs/cf-x86_defconfig
```kconfig
CONFIG_X86=y
CONFIG_SYS_TEXT_BASE=0xFFF00000
CONFIG_MAX_CPUS=2
CONFIG_SMP=y
CONFIG_GENERATE_PIRQ_TABLE=y
CONFIG_GENERATE_MP_TABLE=y
CONFIG_GENERATE_ACPI_TABLE=y
CONFIG_NR_DRAM_BANKS=8
CONFIG_BUILD_ROM=y
CONFIG_ANDROID_BOOT_IMAGE=y
CONFIG_SYS_CONSOLE_INFO_QUIET=y
CONFIG_DISPLAY_BOARDINFO_LATE=y
CONFIG_ANDROID_BOOTLOADER=y
CONFIG_LAST_STAGE_INIT=y
CONFIG_ANDROID_AB=y
CONFIG_HUSH_PARSER=y
CONFIG_CMD_CPU=y
# CONFIG_CMD_FLASH is not set
CONFIG_CMD_GPT=y
# CONFIG_RANDOM_UUID is not set
CONFIG_CMD_PART=y
# CONFIG_CMD_SETEXPR is not set
CONFIG_CMD_BOOT_ANDROID=y
CONFIG_CMD_DHCP=y
# CONFIG_CMD_NFS is not set
CONFIG_CMD_PING=y
CONFIG_CMD_TIME=y
CONFIG_CMD_QFW=y
CONFIG_CMD_EXT2=y
CONFIG_CMD_EXT4=y
CONFIG_CMD_EXT4_WRITE=y
CONFIG_CMD_FAT=y
CONFIG_CMD_FS_GENERIC=y
CONFIG_DEFAULT_DEVICE_TREE="qemu-x86_cuttlefish"
CONFIG_REGMAP=y
CONFIG_SYSCON=y
CONFIG_CPU=y
CONFIG_ENV_IS_IN_RAW_DISK=y
CONFIG_ENV_RAW_DISK_INTERFACE="virtio"
CONFIG_ENV_RAW_DISK_DEVICE_AND_PART="0:1"
```

## u-boot/board/bananapi/bananapi_r2pro/Kconfig
```kconfig
if TARGET_BANANAPI_R2PRO

config SYS_BOARD
	default "bananapi_r2pro"

config SYS_VENDOR
	default "bananapi"

config SYS_CONFIG_NAME
	default "bananapi_r2pro"

config BOARD_SPECIFIC_OPTIONS # dummy
	def_bool y

endif
```
